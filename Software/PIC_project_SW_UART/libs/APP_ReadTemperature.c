#include "BSW_ReadADC.h"
#include "APP_ReadTemperature.h"

// Tabela 16X overampling at 2K4 +100R and 5V
unsigned int T16bit[TABLE_LEN]={0x0D38,0x0D4E,0x0D63,0x0D79,0x0D8F,0x0DA5,0x0DBB,0x0DD1,0x0DE8,0x0DFE,0x0E14,0x0E2B,0x0E41,0x0E58,0x0E6E,0x0E85,0x0E9C,0x0EB2,0x0EC9,0x0EE0, 
                                      0x0EF7,0x0F0E,0x0F25,0x0F3C,0x0F53,0x0F6A,0x0F82,0x0F99,0x0FB0,0x0FC8,0x0FDF,0x0FF7,0x100E,0x1026,0x103D,0x1055,0x106D,0x1084,0x109C,0x10B4, 
                                      0x10CC,0x10E4,0x10FC,0x1114,0x112C,0x1144,0x115C,0x1174,0x118C,0x11A4,0x11BC,0x11D4,0x11EC,0x1205,0x121D,0x1235,0x124D,0x1266,0x127E,0x1296, 
                                      0x12AF,0x12C7,0x12DF,0x12F8,0x1310,0x1329,0x1341,0x1359,0x1372,0x138A,0x13A3,0x13BB,0x13D4,0x13EC,0x1405,0x141D,0x1436,0x144E,0x1467,0x147F, 
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                                      0x1DCF,0x1DE5,0x1DFB,0x1E11,0x1E27,0x1E3D,0x1E52,0x1E68,0x1E7E,0x1E93,0x1EA9,0x1EBE,0x1ED4,0x1EE9,0x1EFE,0x1F14,0x1F29,0x1F3E,0x1F53,0x1F69};


//unsigned char Temperature[ADC_ChanalNo];
int TdC(unsigned int tp_temp)    //Temperatura iz LOOK-up tabele
{
    signed int temp = -50;
    unsigned char cnt =1;
//    tp_temp = tp_temp >> 4;
    while ((T16bit[cnt] < tp_temp)&&(cnt < TABLE_LEN))
    {
        cnt++;
        temp++;
    }
    if (temp > -20)
        temp = temp *10 +((tp_temp -T16bit[cnt -1])*10)/(T16bit[cnt] -T16bit[cnt -1]);
    else
        temp = -999;
    return(temp);
}

int TcPak(unsigned int tp_temp)    //Temperatura iz LOOK-up tabele
{
    signed int temp = -50;
    unsigned char cnt =1;
    while ((T16bit[cnt] < tp_temp)&&(cnt < TABLE_LEN))
    {
        cnt++;
        temp++;
    }
    return(temp);
}


unsigned char Temperatura(unsigned int tp_temp)    //Temperatura iz LOOK-up tabele
{
    unsigned char cnt =1;
    while ((T16bit[cnt] < tp_temp)&&(cnt < TABLE_LEN))
    {
        cnt++;
    }
    return(cnt);
}

void CalcTemps()
{
    unsigned char cnt;
    for(cnt=0; cnt<ADC_ChanalNo; cnt++)
    {
    	Temperature[cnt] = TcPak(ADC_result[cnt]);
    } 

}
